## conf/bblayers.conf
```bitbake
# POKY_BBLAYERS_CONF_VERSION is increased each time build/conf/bblayers.conf
# changes incompatibly
POKY_BBLAYERS_CONF_VERSION = "2"

BBPATH = "${TOPDIR}"
BBFILES ?= ""

BBLAYERS ?= " \
    /BB/bornes/poky-morty/meta \
    /BB/bornes/poky-morty/meta-poky \
    /BB/bornes/poky-morty/meta-openembedded/meta-oe \
    /BB/bornes/poky-morty/meta-openembedded/meta-multimedia \
    /BB/bornes/poky-morty/meta-openembedded/meta-networking \
    /BB/bornes/poky-morty/meta-openembedded/meta-python \
    /BB/bornes/poky-morty/meta-openembedded/meta-webserver \
    /BB/bornes/poky-morty/meta-openembedded/meta-gnome \
    /BB/bornes/poky-morty/meta-qt5 \
    /BB/bornes/poky-morty/meta-browser \
    /BB/bornes/poky-morty/meta-raspberrypi \
    /BB/bornes/BOTER/meta-tl \
  "
```
